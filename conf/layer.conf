## conf/layer.conf
```bitbake
BBPATH .= ":${LAYERDIR}"
BBFILES += "${LAYERDIR}/recipes-*/*/*.bb \
            ${LAYERDIR}/recipes-*/*/*.bbappend"

BBFILE_COLLECTIONS += "snappy"
BBFILE_PATTERN_snappy = "^${LAYERDIR}/"
BBFILE_PRIORITY_snappy = "7"

# This should only be incremented on significant changes that will
# cause compatibility issues with other layers
LAYERVERSION_snappy = "1"
LAYERDEPENDS_snappy = "core filesystems-layer"
```
